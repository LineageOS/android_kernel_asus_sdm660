## drivers/input/fingerprint/Kconfig
```kconfig
#
# Fingerprint driver configuration
#

if MACH_ASUS_X00TD

menuconfig INPUT_FINGERPRINT
	bool "Fingerprint"
	help
	  Say Y here, and a list of supported fingerprint will be displayed.
	  This option doesn't affect the kernel.

	  If unsure, say Y.

if INPUT_FINGERPRINT

config COMMON_FP
	bool "Fingerprint common"
	help
	  Say Y here if you use common fp.

	  If unsure, say N.

config CDFINGER_FP
	bool "Fingerprint cdfinger"
	select COMMON_FP
	help
	  Say Y here if you use common fp.

	  If unsure, say N.

config GOODIX_FP
	bool "Fingerprint goodix"
	select COMMON_FP
	help
	  Say Y here if you use common fp.

	  If unsure, say N.

endif 
endif

if MACH_ASUS_X01BD

menuconfig INPUT_FINGERPRINT
	bool "Fingerprint"
	help
	  Say Y here, and a list of supported fingerprint will be displayed.
	  This option doesn't affect the kernel.

	  If unsure, say Y.

if INPUT_FINGERPRINT

config X01BD_CDFINGER_FP
    bool "Fingerprint cdfinger"
	help
		Say Y here if you use common fp.
		If unsure, say N.

config X01BD_FOCALTECH_FP
    bool "Fingerprint focaltech"
	help
		Say Y here if you use focaltech fp.
		If unsure, say N.

endif
endif
```

## drivers/misc/huaqin/Kconfig
```kconfig
#
# for huaqin mis info
#

# Huaqin add for ZQL1650-86 by liunianliang at 2018/02/09 start
config HQ_HARDWARE_INFO
	bool "show hardware info"
        default y
	help
	  this will create proc/hardwareinfo to show some hardware information.

	  If unsure, say N.
# Huaqin add for ZQL1650-86 by liunianliang at 2018/02/09 end
```

## drivers/sensors/Kconfig
```kconfig
config SENSORS_SSC
	bool "Enable Sensors Driver Support for SSC"
	help
	  Add support for sensors SSC driver.
	  This driver is used for exercising sensors use case,
	  time syncing with ADSP clock.
#Huaqin add for ZQL1650-141 by chenyijun5 at 2018/02/01 start
config INPUT_STK3321
	tristate "STK STK3321 alsps sensor"
	depends on I2C
	help
	  Say Y here to enable the STK3321 ALSPS Sensor.
#Huaqin add for ZQL1650-141 by chenyijun5 at 2018/02/01 end
```
